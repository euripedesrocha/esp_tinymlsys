## esp_execution/examples/blink/main/Kconfig.projbuild
```kconfig
menu "esp-execution blink example"

    config ESP_EXECUTION_BLINK_GPIO
        int "DevKitC-1 RGB LED GPIO"
        range 0 48
        default 38
        help
            ESP32-S3-DevKitC-1 v1.1 uses GPIO38. Set this to GPIO48 for a v1.0 board.

    config ESP_EXECUTION_BLINK_PERIOD_MS
        int "Blink period in milliseconds"
        range 1 60000
        default 500

endmenu
```

## esp_freertos_cpp/test_apps/catch2/sdkconfig.defaults.esp32s3
```kconfig
# SPDX-FileCopyrightText: 2026 Euripedes Rocha
# SPDX-License-Identifier: Apache-2.0

CONFIG_ESP_CONSOLE_USB_SERIAL_JTAG=y
CONFIG_ESP_CONSOLE_SECONDARY_NONE=y
```

## esp_memory/test_apps/catch2/sdkconfig.defaults
```kconfig
CONFIG_IDF_TARGET="esp32s3"
CONFIG_IDF_TARGET_ESP32S3=y
# CONFIG_COMPILER_STATIC_ANALYZER is not set
CONFIG_COMPILER_CXX_EXCEPTIONS=y
CONFIG_COMPILER_CXX_EXCEPTIONS_EMG_POOL_SIZE=4096
CONFIG_ESP_CONSOLE_USB_SERIAL_JTAG=y
CONFIG_ESP_CONSOLE_SECONDARY_NONE=y
```

## esp_memory/test_apps/verify/sdkconfig.defaults
```kconfig
CONFIG_IDF_TARGET="esp32s3"
CONFIG_IDF_TARGET_ESP32S3=y
CONFIG_COMPILER_CXX_EXCEPTIONS=y
CONFIG_COMPILER_CXX_EXCEPTIONS_EMG_POOL_SIZE=4096
```

## esp_tensor/Kconfig
```kconfig
menu "ESP Tensor"

    choice ESP_TENSOR_CONTRACT_MODE
        prompt "C++26 contract evaluation mode"
        default ESP_TENSOR_CONTRACT_MODE_ENFORCE
        help
            Select how C++26 contract checks are evaluated when building
            esp_tensor.

    config ESP_TENSOR_CONTRACT_MODE_ENFORCE
        bool "Enforce contracts"
        help
            Evaluate contract predicates and call the contract violation
            handler when a predicate is false.

    config ESP_TENSOR_CONTRACT_MODE_IGNORE
        bool "Ignore contracts"
        help
            Compile contract annotations without evaluating predicates.

    endchoice

endmenu
```

## pbt_test/sdkconfig.defaults
```kconfig
CONFIG_COMPILER_CXX_EXCEPTIONS=y
CONFIG_ESP_CONSOLE_USB_SERIAL_JTAG=y
CONFIG_ESP_CONSOLE_SECONDARY_NONE=y
CONFIG_ESPTOOLPY_FLASHSIZE_8MB=y
CONFIG_PARTITION_TABLE_SINGLE_APP_LARGE=y
CONFIG_SPIRAM=y
CONFIG_SPIRAM_MODE_OCT=y
CONFIG_SPIRAM_SPEED_80M=y
CONFIG_SPIRAM_TYPE_AUTO=y
CONFIG_SPIRAM_USE_CAPS_ALLOC=y
```

## test/sdkconfig.defaults
```kconfig
CONFIG_COMPILER_CXX_EXCEPTIONS=y
CONFIG_ESP_CONSOLE_USB_SERIAL_JTAG=y
CONFIG_ESP_CONSOLE_SECONDARY_NONE=y
```
